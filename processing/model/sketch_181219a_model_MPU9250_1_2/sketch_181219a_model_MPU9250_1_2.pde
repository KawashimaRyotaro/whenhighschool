import processing.serial.*;

double gx, gy, gz, ax, ay, az, mx, my, mz;

////////////////////////////////////////波形保存////////////////////////////////////////////////////////////////////////////////////////////////////////////////////////////////////////////////////////////////////////////////////
double[][] gx1,    gy1,    gz1;

///////////////////////////////////////1サイクルの合計//////////////////////////////////////////////////////////////////////////////////////////////////////////////////////////////////////////////////////////////////////////////
double[]   sgx_1,  sgy_1,  sgz_1;

////////////////////////////////////////////1サイクルの平均/////////////////////////////////////////////////////////////////////////////////////////////////////////////////////////////////////////////////////////////////////////
double[]   avgx_1, avgy_1, avgz_1;

/////////////////////////////////////////分散///////////////////////////////////////////////////////////////////////////////////////////////////////////////////////////////////////////////////////////////////////////////////////
double[]   gxs_1,  gys_1,  gzs_1;

//////////////////////////////////////////平均波////////////////////////////////////////////////////////////////////////////////////////////////////////////////////////////////////////////////////////////////////////////////////
double[]   avgx1,  avgy1,  avgz1;
double[]   avgx2,  avgy2,  avgz2;

/////////////////////////////////////////分散逆数・ゲイン////////////////////////////////////////////////////////////////////////////////////////////////////////////////////////////////////////////////////////////////////////////
double[]   a1,     a2,     a3;
double     S1=0,   S2=0,   S3=0,   S4=0,   S5=0,   S6=0,   S7=0,   S8=0,   S9=0,   K=1,   k1=5, k2=100;

/////////////////////////////////////////////その他/////////////////////////////////////////////////////////////////////////////////////////////////////////////////////////////////////////////////////////////////////////////////
double     x=0,    y=0,    z=0;
double     x1,     y1,     z1;
int       num1=0, num2=0, num3=0, n1=1, n2=1, a=0;
int       serialTimer;
Serial myPort;














void setup() {
  
///////////////////////////////////////////////////////////////////////////////////////////////////////////////////////////////////////////////////////////////////////////////////////////////////////////////////////////////////
                                                                                 /*配列宣言*/
//g値

    gx1=new double[n1+1][n2];     
    gy1=new double[n1+1][n2];
    gz1=new double[n1+1][n2];  
  
//sum値

    sgx_1=new double[n1+1];
    sgy_1=new double[n1+1];
    sgz_1=new double[n1+1];
    for(int i=0; i<=n1; i++){
        sgx_1[i]=0;
        sgy_1[i]=0;
        sgz_1[i]=0;
    }

//av値

    avgx_1=new double[n1+1];
    avgy_1=new double[n1+1];
    avgz_1=new double[n1+1];
  
//s値
  
    gxs_1=new double[n1+1];
    gys_1=new double[n1+1];
    gzs_1=new double[n1+1];
  

//av波

    avgx1=new double[n2];  
    avgy1=new double[n2];
    avgz1=new double[n2];    
    avgx2=new double[n2];  
    avgy2=new double[n2];
    avgz2=new double[n2];   
  
//分散ゲイン
  
    a1=new double[n1];
    a2=new double[n1];
    a3=new double[n1];
///////////////////////////////////////////////////////////////////////////////////////////////////////////////////////////////////////////////////////////////////////////////////////////////////////////////////////////////////
  
///////////////////////////////////////////////////////////////////////////////////////////////////////////////////////////////////////////////////////////////////////////////////////////////////////////////////////////////////
                                                                           /*画面生成ステップ*/
  
    size(1000, 1000, P3D);
    myPort = new Serial(this, "COM4", 57600);
}

void draw() {
///////////////////////////////////////////////////////////////////////////////////////////////////////////////////////////////////////////////////////////////////////////////////////////////////////////////////////////////////
  
///////////////////////////////////////////////////////////////////////////////////////////////////////////////////////////////////////////////////////////////////////////////////////////////////////////////////////////////////
                                                                          /*シリアル通信ステップ*/

    if (millis()-serialTimer > 50) {
        serialTimer = millis();
        byte[] inBuf = new byte[20];
        println(myPort.available());
        if (myPort.available() == 20) {
            myPort.readBytes(inBuf);
            if (inBuf[0]=='s'&&inBuf[19]=='e') {
                gx = (inBuf[1]<<8)+(inBuf[2]&0xff);
                gy = (inBuf[3]<<8)+(inBuf[4]&0xff);
                gz = (inBuf[5]<<8)+(inBuf[6]&0xff);
                ax = (inBuf[7]<<8)+(inBuf[8]&0xff);
                ay = (inBuf[9]<<8)+(inBuf[10]&0xff);
                az = (inBuf[11]<<8)+(inBuf[12]&0xff);
                mx = (inBuf[13]<<8)+(inBuf[14]&0xff);
                my = (inBuf[15]<<8)+(inBuf[16]&0xff);
                mz = (inBuf[17]<<8)+(inBuf[18]&0xff);
                gx/=10000.0;
                gy/=10000.0;
                gz/=10000.0;
                gx+=0.01;
                gy+=-0.01;
                gz+=0.01-0.00152;
                gx=gx*90/50;
                gy=gy*90/53;
                gz=gz*90/53;
                ax/=100.0;
                ay/=100.0;
                az/=100.0;
                mx/=100.0;
                my/=100.0;
                mz/=100.0;
                ax-=2;
                ay-=1;
                az-=1;
            } else {
                while (myPort.available()>0)myPort.read();
                println("missMatch");
            }
        } else if (myPort.available() > 14) {
            while (myPort.available()>0)myPort.read();
            println("overflowe");
        }

        byte[] outBuf = new byte[1];
        outBuf[0]     = 's';
        myPort.write(outBuf);
    }
///////////////////////////////////////////////////////////////////////////////////////////////////////////////////////////////////////////////////////////////////////////////////////////////////////////////////////////////////

///////////////////////////////////////////////////////////////////////////////////////////////////////////////////////////////////////////////////////////////////////////////////////////////////////////////////////////////////
                                                                                  /*a補正ステップ*/
  
    if(ax>=100){
    
        ax=100;
    }else if(ax<=-100){
    
        ax=-100;
    }else if(ay>=100){
    
        ay=100;
    }else if(ay<=-100){
    
        ay=-100;
    }else if(az>=100){
    
        az=100;
    }else if(az<=-100){
    
        az=-100;
    }
///////////////////////////////////////////////////////////////////////////////////////////////////////////////////////////////////////////////////////////////////////////////////////////////////////////////////////////////////

///////////////////////////////////////////////////////////////////////////////////////////////////////////////////////////////////////////////////////////////////////////////////////////////////////////////////////////////////
                                                                                /*g補正ステップ*/
                                                                                
    //第一フェーズ
    if(num2<n1 && num3<n2){
      
        //波の保存  
        gx1[num2][num3]=gx;
        gy1[num2][num3]=gy;
        gz1[num2][num3]=gz;
        
        //波の加算
        sgx_1[num2]+=gx;
        sgy_1[num2]+=gy;
        sgz_1[num2]+=gz;
    }
    
    if(num2<n1 && num3==n2){
      
        //波の平均  
        avgx_1[num2]=sgx_1[num2]/n2;
        avgy_1[num2]=sgy_1[num2]/n2;
        avgz_1[num2]=sgz_1[num2]/n2;
        
        //波の分散（信頼度）算出
        for(int i=0; i<n2; i++){
            gxs_1[num2]+=sq((float)gx1[num2][i]-(float)avgx_1[num2]);
            gys_1[num2]+=sq((float)gy1[num2][i]-(float)avgy_1[num2]);
            gzs_1[num2]+=sq((float)gz1[num2][i]-(float)avgz_1[num2]);
        }
        gxs_1[num2]=sqrt((float)gxs_1[num2]/num3);
        gys_1[num2]=sqrt((float)gys_1[num2]/num3);
        gzs_1[num2]=sqrt((float)gys_1[num2]/num3);
        sgx_1[num2]=0;
        sgy_1[num2]=0;
        sgz_1[num2]=0;                     //合計リセット
        num3=0;                            //波リセット
        num2++;                            //波切り替え
        
        //num3=0の時の値保存
        if(num2<n1){
            gx1[num2][num3]=gx;
            gy1[num2][num3]=gy;
            gz1[num2][num3]=gz;
            sgx_1[num2]+=gx;
            sgy_1[num2]+=gy;
            sgz_1[num2]+=gz;
        }
  
        //第二フェーズ
        if(num2==n1){
  
            //必要データ取得
            for(int j=0; j<n1; j++){
              
                if(gxs_1[j]==0){
                  gxs_1[j]=0.001;
                }
                
                a1[j]=1/gxs_1[j];
                
                if(gys_1[j]==0){
                  gys_1[j]=0.001;
                }
                
                a2[j]=1/gys_1[j];
                
                if(gzs_1[j]==0){
                  gzs_1[j]=0.001;
                }
                
                a3[j]=1/gzs_1[j];
                S1+=a1[j];
                S2+=a2[j];
                S3+=a3[j];
            }

            //平均波記憶
            for(int i=0; i<n2; i++){
                for(int j=0; j<n1; j++){
                    avgx1[i]+=gx1[j][i]*a1[j];
                    avgy1[i]+=gy1[j][i]*a2[j];
                    avgz1[i]+=gz1[j][i]*a3[j];
                }
                avgx1[i]/=S1;
                avgy1[i]/=S2;
                avgz1[i]/=S3;
            }
          num3=0;      //波リセット
          }
      }
  
    //第三フェーズ
    //平均波、平均ドリフトで引く
    if(num3<n2&&num2==n1){
        gx-=avgx1[num3];
        gy-=avgy1[num3];
        gz-=avgz1[num3];
          
        //波形保存
        gx1[n1][num3]=gx;
        gy1[n1][num3]=gy;
        gz1[n1][num3]=gz;
        sgx_1[n1]+=gx;
        sgy_1[n1]+=gy;
        sgz_1[n1]+=gz;
        num1++;           //タイム加算
    }
    
    //第四フェーズ
    if(num2==n1 && num3==n2){
    
        //平均算出
        avgx_1[n1]=sgx_1[n1]/num3;
        avgy_1[n1]=sgy_1[n1]/num3;
        avgz_1[n1]=sgz_1[n1]/num3;
       
        //合計リセット
        sgx_1[n1]=0;
        sgy_1[n1]=0;
        sgz_1[n1]=0;
       
        //分散算出
        for(int i=0; i<n2; i++){
            gxs_1[n1]+=sq((float)gx1[n1][i]);
            gys_1[n1]+=sq((float)gy1[n1][i]);
            gzs_1[n1]+=sq((float)gy1[n1][i]);
        }
   
        gxs_1[n1]=sqrt((float)gxs_1[n1]/num3);
        gys_1[n1]=sqrt((float)gys_1[n1]/num3);
        gzs_1[n1]=sqrt((float)gzs_1[n1]/num3);
    
        //記憶フェーズ
        //g値保存
        for(int i=0; i<n2; i++){
            for(int j=0; j<n1; j++){
                gx1[j][i]=gx1[j+1][i];
                gy1[j][i]=gy1[j+1][i];
                gz1[j][i]=gz1[j+1][i];
            }
        }

    
        //平均、分散保存
        for(int i=0; i<n1; i++){
            gxs_1[i]=gxs_1[i+1];
            gys_1[i]=gys_1[i+1];
            gzs_1[i]=gzs_1[i+1];
            avgx_1[i]=avgx_1[i+1];
            avgy_1[i]=avgy_1[i+1];
            avgz_1[i]=avgz_1[i+1];
        }
           
        //平均波更新
        for(int j=0; j<n1; j++){
            
            if(gxs_1[j]==0){
                  gxs_1[j]=0.001;
            }
            
            a1[j]=1/gxs_1[j];
            
            if(gys_1[j]==0){
                gys_1[j]=0.001;
            }
            
            a2[j]=1/gys_1[j];
            
            if(gzs_1[j]==0){
                gzs_1[j]=0.001;
            }
            
            a3[j]=1/gzs_1[j];
            S1+=a1[j];
            S2+=a2[j];
            S3+=a3[j];
        }
       
        S4=k1*S1;
        S5=k1*S2;
        S6=k1*S3;
        S7=S1+S4;
        S8=S2+S5;
        S9=S3+S6;
    
        for(int i=0; i<n2; i++){
            avgx1[i]+=avgx1[i]*S4;
            avgy1[i]+=avgy1[i]*S5;
            avgz1[i]+=avgz1[i]*S6;
            for(int j=0; j<n1; j++){
                avgx1[i]+=gx1[j][i]*a1[j];
                avgy1[i]+=gy1[j][i]*a2[j];
                avgz1[i]+=gz1[j][i]*a3[j];
            }
            avgx1[i]/=S7;
            avgy1[i]/=S8;
            avgz1[i]/=S9;
        }
        num1++;               //安定タイム加算
        num3=0;               //波リセット
      }

//角度積算

    if(num1>=1000){
        x+=gx;
        y+=gy;
        z+=gz;
///////////////////////////////////////////////////////////////////////////////////////////////////////////////////////////////////////////////////////////////////////////////////////////////////////////////////////////////////
    }
  
///////////////////////////////////////////////////////////////////////////////////////////////////////////////////////////////////////////////////////////////////////////////////////////////////////////////////////////////////
                                                             /*モニターステップ*/
  
    background(255);
    fill(0);
    
    textSize(24);
    plint_tex();
    text((float)gx*100, 50, 50);
    text((float)gy*100, 50, 80);
    text((float)gz*100, 50, 110);
    text((float)ax, 50, 140);
    text((float)ay, 50, 170);
    text((float)az, 50, 200);
    text((float)mx, 50, 230);
    text((float)my, 50, 260);
    text((float)mz, 50, 290);
    text((float)x, 50, 320);
    text((float)y, 50, 350);
    text((float)z, 50, 380);
    text((float)sgx_1[num2], 50, 410);
    text((float)num3, 50, 440);
    text((float)num2, 50, 470);
    if(num2>0){
        text((float)avgx_1[n1], 50, 500);
        /*text((float)gxs_1[5], 50, 590);*/
    }
    text((float)a, 50, 530);
    text((float)0, 50, 560);
    num3++;
///////////////////////////////////////////////////////////////////////////////////////////////////////////////////////////////////////////////////////////////////////////////////////////////////////////////////////////////////
}
///////////////////////////////////////////////////////////////////////////////////////////////////////////////////////////////////////////////////////////////////////////////////////////////////////////////////////////////////
                                                               /*表題ステップ*/

void plint_tex(){
    text("gx:", 10, 50);
    text("gy:", 10, 80);
    text("gz:", 10, 110);
    text("ax:", 10, 140);
    text("ay:", 10, 170);
    text("az:", 10, 200);
    text("mx:", 10, 230);
    text("my:", 10, 260);
    text("mz:", 10, 290);
    text("x:", 10, 320);
    text("y:", 10, 350);
    text("z:", 10, 380);
    text("x1:", 10, 410);
    text("y1:", 10, 440);
    text("z1:", 10, 470);
}
///////////////////////////////////////////////////////////////////////////////////////////////////////////////////////////////////////////////////////////////////////////////////////////////////////////////////////////////////
